## CMakeLists.txt
```
cmake_minimum_required(VERSION 3.20.0)
find_package(Zephyr REQUIRED HINTS $ENV{ZEPHYR_BASE})

project(CODEC_test)

target_sources(app PRIVATE src/main.c)

# Exclude files with main function
list(APPEND EXCLUDE_FILES
    "${CMAKE_CURRENT_SOURCE_DIR}/inc/opus/celt/dump_modes/dump_modes.c"
    "${CMAKE_CURRENT_SOURCE_DIR}/inc/opus/src_c/opus_compare.c"
    "${CMAKE_CURRENT_SOURCE_DIR}/inc/opus/src_c/opus_demo.c"
    "${CMAKE_CURRENT_SOURCE_DIR}/inc/opus/src_c/repacketizer_demo.c"
)

FILE(GLOB audio_sources
    ${CMAKE_CURRENT_SOURCE_DIR}/inc/opus/*.c

    ${CMAKE_CURRENT_SOURCE_DIR}/inc/opus/celt/*.c
    ${CMAKE_CURRENT_SOURCE_DIR}/inc/opus/celt/arm/*.c
    ${CMAKE_CURRENT_SOURCE_DIR}/inc/opus/celt/dump_modes/*.c

    ${CMAKE_CURRENT_SOURCE_DIR}/inc/opus/silk/*.c
    ${CMAKE_CURRENT_SOURCE_DIR}/inc/opus/silk/arm/*.c
    ${CMAKE_CURRENT_SOURCE_DIR}/inc/opus/silk/fixed/*.c
    ${CMAKE_CURRENT_SOURCE_DIR}/inc/opus/silk/fixed/arm/*.c
    ${CMAKE_CURRENT_SOURCE_DIR}/inc/opus/silk/float/*.c

    ${CMAKE_CURRENT_SOURCE_DIR}/inc/opus/libc_opus/*.c

    ${CMAKE_CURRENT_SOURCE_DIR}/inc/opus/src_c/*.c
    )

foreach(file ${EXCLUDE_FILES})
    list(REMOVE_ITEM audio_sources ${file})
endforeach()

target_sources(app PRIVATE ${audio_sources})

target_include_directories(app PRIVATE
    inc/opus
    inc/opus/libc_opus
    inc/opus/include
    inc/opus/celt
    inc/opus/celt/arm
    inc/opus/celt/dump_modes
    inc/opus/silk
    inc/opus/silk/arm
    inc/opus/silk/fixed
    inc/opus/silk/fixed/arm
    inc/opus/silk/float
    ${ZEPHYR_NRF_MODULE_DIR}/boards/arm/nrf5340_audio_dk_nrf5340
)


# For OPUS
set(CMAKE_C_FLAGS "${CMAKE_C_FLAGS} \
-DARM_MATH_CM4 \
-DUSE_ALLOCA \
-DHAVE_LRINT \
-DHAVE_LRINTF \
-DCUSTOM_SUPPORT \
-DVAR_ARRAYS \
-DOPUS_BUILD \
-DHAVE_CONFIG_H \
-g \
-mfpu=fpv5-sp-d16 \
-mfloat-abi=hard \
-mcpu=cortex-m33 \
-mthumb \
")
```

## prj.conf
```kconfig
CONFIG_FPU=y

CONFIG_LOG=y
CONFIG_LOG_DEFAULT_LEVEL=4
CONFIG_LOG_BACKEND_UART=y
```

## src/main.c
```c
#include <stdio.h>
#include <stdlib.h>
#include <string.h>

#include "../inc/opus/audio_codec_opus_api.h"
#include "zephyr/logging/log.h"

#define INPUT_DATA_SIZE CONFIG_AUDIO_FRAME_SIZE_SAMPLES*CONFIG_CHANNELS
#define OUTPUT_DATA_SIZE CONFIG_AUDIO_FRAME_SIZE_SAMPLES*CONFIG_CHANNELS

void fill_with_constant_data(int16_t *data, size_t size, int16_t value) {
    for (size_t i = 0; i < size / sizeof(int16_t); i++) {
        data[i] = value;
    }
}

void print_data(const char *label, const uint8_t *data, size_t size) {
    fprintf(stderr, "%s\n", label);
    for (size_t i = 0; i < size; i++) {
        fprintf(stderr, "%02x ", data[i]);
    }
    fprintf(stderr, "\n");
}

int main() {
    // Initialize Opus codec
    audio_codec_opus_init();

    // Prepare buffers
    int16_t Data_In[INPUT_DATA_SIZE];
    int16_t Data_Out[OUTPUT_DATA_SIZE];
    
    m_audio_frame_t frame_OPUS_encode;
    m_audio_frame_t frame_OPUS_decode;

    // Fill with constant data for test
    fill_with_constant_data((int16_t *)Data_In, INPUT_DATA_SIZE, 60);

    // Prepare encoding frame
    frame_OPUS_encode.data_size = INPUT_DATA_SIZE;
    memcpy(frame_OPUS_encode.data, Data_In, INPUT_DATA_SIZE);

    // Encode data
    drv_audio_codec_encode((int16_t *)Data_In, &frame_OPUS_encode);

    // Log encoded data
    fprintf(stderr, "Encoded data size: %d\n", frame_OPUS_encode.data_size);
    print_data("Encoded data:", frame_OPUS_encode.data, frame_OPUS_encode.data_size);

    // Prepare decoding frame
    frame_OPUS_decode.data_size = frame_OPUS_encode.data_size;
    memcpy(frame_OPUS_decode.data, frame_OPUS_encode.data, frame_OPUS_encode.data_size);

    // Decode data
    drv_audio_codec_decode(&frame_OPUS_encode, (int16_t *)Data_Out);

    // Log decoded data
    print_data("Decoded data:", (uint8_t *)Data_Out, INPUT_DATA_SIZE);

    // Optionally compare original and decoded data
    int match = 1;
    for (size_t i = 0; i < INPUT_DATA_SIZE / sizeof(int16_t); i++) {
        if (((int16_t *)Data_In)[i] != ((int16_t *)Data_Out)[i]) {
            fprintf(stderr, "Mismatch at index %zu: Original = %d, Decoded = %d\n", i, ((int16_t *)Data_In)[i], ((int16_t *)Data_Out)[i]);
            match = 0;
        }
    }

    if (match) {
        fprintf(stderr, "Data match\n");
    } else {
        fprintf(stderr, "Data do not match\n");
    }

    return 0;
}
```
